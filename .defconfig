## .defconfig
```kconfig
#
# Lambda Kernel Configuration
#
CONFIG_ARCH_X86=y
# CONFIG_ARCH_ARM32 is not set
# CONFIG_ARCH_RISCV is not set

#
# x86 architecture
#
# CONFIG_ARCH_CPU_386 is not set
CONFIG_ARCH_CPU_486=y
# CONFIG_ARCH_CPU_P5 is not set
# CONFIG_ARCH_CPU_P6 is not set
CONFIG_ARCH_HW_PC=y

#
# CPU Features
#

#
# Paging
#
CONFIG_X86_PAGING_KERNEL_WP=y
# end of Paging

# CONFIG_X86_APIC is not set
# end of CPU Features

CONFIG_MULTIBOOT=y
CONFIG_MULTIBOOT_VERSION=2
# end of x86 architecture

CONFIG_LOG_COLORCODE=y
# CONFIG_EMBEDDED_INITRD is not set
CONFIG_SAFETY_CHECKS=y
CONFIG_STRICTNESS=255
CONFIG_CRYPTO=y
CONFIG_CRYPTO_COMP=y
CONFIG_CRYPTO_COMP_LZOP=y
CONFIG_IPC=y

#
# Processes and threads
#
CONFIG_PROC_KERN_STACK_SIZE=4096
CONFIG_PROC_USER_STACK_SIZE=32768
CONFIG_PROC_USER_STACK_SIZE_MAX=65536
# CONFIG_PROC_STACK_GUARD is not set
# CONFIG_KTASK_DEBUGGER is not set
# end of Processes and threads
# end of Lambda Kernel Configuration

#
# Modules Configuration
#

#
# Hardware Support
#

#
# I/O Devices
#

#
# Serial Devices
#
# CONFIG_MOD_DRV_IO_SERIAL_8250 is not set
# end of Serial Devices
# end of I/O Devices
# end of Hardware Support

#
# Filesystem Support
#
CONFIG_MOD_FS_DEVFS=y
CONFIG_MOD_FS_DEVMEM=y
CONFIG_MOD_FS_DEVNULL=y
# end of Filesystem Support

#
# TTY Support
#
# CONFIG_MOD_TTY_TTY is not set
# end of TTY Support
# end of Modules Configuration

#
# General build options
#
CONFIG_BUILD_USE_WERROR=y
# CONFIG_BUILD_USE_CLANG is not set
# end of General build options
```

## kernel/Kconfig
```kconfig
menu "Lambda Kernel Configuration"

source "kernel/arch/Kconfig"
source "kernel/src/Kconfig"

endmenu
```

## kernel/src/ipc/Kconfig
```kconfig
menuconfig IPC
    bool "IPC (Inter-Process Communication) support (experimental)"
    default y

if IPC
endif # IPC
```

## modules/modules/Kconfig
```kconfig
source "modules/modules/drv/Kconfig"
source "modules/modules/fs/Kconfig"
#source "modules/modules/test/Kconfig"
source "modules/modules/tty/Kconfig"
```

## modules/modules/drv/io/serial/Kconfig
```kconfig
menu "Serial Devices"

config MOD_DRV_IO_SERIAL_8250
    bool "8250-compatible UART support (experimental)"
    default n

endmenu
```

## modules/modules/fs/Kconfig
```kconfig
menu "Filesystem Support"

config MOD_FS_DEVFS
    bool "Base /dev filesystem"
    default y

config MOD_FS_DEVMEM
    bool "/dev/mem support"
    default y
    depends on MOD_FS_DEVFS

config MOD_FS_DEVNULL
    bool "/dev/null support"
    default y
    depends on MOD_FS_DEVFS

endmenu
```

## modules/modules/tty/Kconfig
```kconfig
menu "TTY Support"

config MOD_TTY_TTY
    bool "Base TTY support (experimental)"
    default n

endmenu
```

## user/utils/testing/Kconfig
```kconfig
menu "Testing Utilities"

config USER_UTILS_TEST_IPC_SRV
    bool "ipc_srv (IPC test server)"
    default y

config USER_UTILS_TEST_IPC_CLIENT
    bool "ipc_client (IPC test client)"
    default y

endmenu
```
